#include <stddef.h>
#include <stdint.h>
#include <math.h>
#include "esp_log.h"
#include "freertos/FreeRTOS.h"
#include "freertos/queue.h"
#include "freertos/semphr.h"
#include "include/types.h"
#include "include/defines.h"
#include "include/handles.h"
#include "include/analysis.h"
#include "include/patterngen.h"

extern float AWeights[];
bool polar(float *in, float *out, size_t len)
{
	if (!(in && out && len%2==0)) return false;

	for (int i = 1; i < len/2; i++)
	{
		float re = in[i];
		float im = in[len-i];
		float mag = hypotf(re, im);
		float phase = atan2f(im, re);
		out[i] = mag;
		out[len-i] = phase;
	}
	return true;
}

float bisectAngle(float a, float b)
{
	float cx, cy;

	cx = cosf(a) + cosf(b);
	cy = sinf(a) + sinf(b);

	return atan2f(cy, cx);
}

bool averagechannels(float *r, float *l, float *out, size_t len)
{
	out[0] = (r[0] + l[0]) / 2.0f;
	out[len/2] = (r[len/2] + l[len/2]) / 2.0f;
	for (int i = 1; i < len/2; i++)
	{
		out[i] = (r[i] + l[i]) / 2.0f;
		out[len-i] = bisectAngle(r[len-i], l[len-i]);
	}
	return true;
}

bool AWeight(float *buf, size_t len)
{
	for (int i = 0; i < len/2; i++)
	{
		buf[i] *= AWeights[i];
	}
	return true;
}

//void AnalysisTask(void *ignored)
//{
//	for(;;)
//	{
//		pixel *buf = NULL;
//		pixel *rb = NULL;
//		pixel *VU = NULL;
//		pixel *ph = NULL;
//		pixel *df = NULL;
//
//		float *lhandle = NULL;
//		float *rhandle = NULL;
//
//		float *rainbowHandle = malloc(sizeof(float) * FFTLEN);
//
//		xQueueReceive(freqDataQueue, &lhandle, portMAX_DELAY);
//		xQueueReceive(freqDataQueue, &rhandle, portMAX_DELAY);
//
//		if (lhandle&&rhandle)
//		{
//			polar(lhandle, lhandle, FFTLEN);
//			polar(rhandle, rhandle, FFTLEN);
//			AWeight(lhandle, FFTLEN);
//			AWeight(rhandle, FFTLEN);
//
//			if (rainbowHandle)
//			{
//				averagechannels(lhandle, rhandle, rainbowHandle, FFTLEN);
//				rb = rainbow(rainbowHandle);
//			}
//
//			VU = VUMeter(lhandle, rhandle);
//			ph = phase(lhandle, rhandle);
//			df = difference(lhandle, rhandle);
//		}
//		if (lhandle) free(lhandle);
//		if (rhandle) free(rhandle);
//		lhandle = NULL;
//		rhandle = NULL;
//		if (rb)
//		{
//			xQueueReceive(LEDEmptyBufferQueue, &buf, portMAX_DELAY);
//			if (buf)
//			{
//				for ( int i = 0; i < NUMLEDS ; i++)
//				{
//					buf[i] = rb[i];
//				}
//				xQueueSendToBack(rainbowDataBufferQueue, &buf, portMAX_DELAY);
//			}
//			free(rb);
//			rb = NULL;
//		}
//		if (VU)
//		{
//			xQueueReceive(LEDEmptyBufferQueue, &buf, portMAX_DELAY);
//			if (buf)
//			{
//				for ( int i = 0; i < NUMLEDS ; i++)
//				{
//					buf[i] = VU[i];
//				}
//				xQueueSendToBack(VUMeterDataBufferQueue, &buf, portMAX_DELAY);
//			}
//			free(VU);
//			VU = NULL;
//		}
//		if (ph)
//		{
//			xQueueReceive(LEDEmptyBufferQueue, &buf, portMAX_DELAY);
//			if (buf)
//			{
//				for ( int i = 0; i < NUMLEDS ; i++)
//				{
//					buf[i] = ph[i];
//				}
//				xQueueSendToBack(diffDataBufferQueue, &buf, portMAX_DELAY);
//			}
//			free(ph);
//			ph = NULL;
//		}
//		if (df)
//		{
//			xQueueReceive(LEDEmptyBufferQueue, &buf, portMAX_DELAY);
//			if (buf)
//			{
//				for ( int i = 0; i < NUMLEDS ; i++)
//				{
//					buf[i] = df[i];
//				}
//				xQueueSendToBack(phaseDataBufferQueue, &buf, portMAX_DELAY);
//			}
//			free(df);
//			df = NULL;
//		}
//	}
//	vTaskDelete(NULL);
//	return;
//}

void HSVtoRGB(const HSVpixel *hsv, pixel *rgb)
{
	if (!(hsv && rgb)) return;
	if (hsv->saturation < 0.0001f)
	{
		rgb->red = rgb->green = rgb->blue = hsv->value*256;
		return;
	}
	float hue = hsv->hue;
	float sat = hsv->saturation;
	float val = hsv->value;

	if (hue < 0.0f)
	{
		int mult = (int)(hue/-360.0f) + 1;
		hue += 360.0f * (float) mult;
	}
	if (hue >= 360.0f) hue = fmodf(hue, 360.0f);
	if (sat < 0.0f) sat = 0.0f;
	if (sat > 1.0f) sat = 1.0f;
	if (val < 0.0f) val = 0.0f;
	if (val > 1.0f) val = 1.0f;

	float top = val;
	float bot = val * (1.0f - sat);
	float slope = 0.0f;
	float hd = fmodf(hue, 60.0f)/60.0f;
	int sextant = hue/60.0f;

	if (sextant & 1) slope = val*(1.0-(sat*hd));
	else slope = val*(1.0-sat*(1.0-hd));

	switch (sextant)
	{
		case 0:
			rgb->red = top*255.999;
			rgb->green = slope*255.999;
			rgb->blue = bot*255.999;
			break;
		case 1:
			rgb->red = slope*255.999;
			rgb->green = top*255.999;
			rgb->blue = bot*255.999;
			break;
		case 2:
			rgb->red = bot*255.999;
			rgb->green = top*255.999;
			rgb->blue = slope*255.999;
			break;
		case 3:
			rgb->red = bot*255.999;
			rgb->green = slope*255.999;
			rgb->blue = top*255.999;
			break;
		case 4:
			rgb->red = slope*255.999;
			rgb->green = bot*255.999;
			rgb->blue = top*255.999;
			break;
		case 5:
			rgb->red = top*255.999;
			rgb->green = bot*255.999;
			rgb->blue = slope*255.999;
			break;
	}
	return;
}

float AWeights[FFTLEN/2] = {
0.000392, 0.003759, 0.011242, 0.022163, 0.035723, 0.051261, 0.068239, 0.086226, 0.104885, 0.123958, 0.143252, 0.162624,
0.181970, 0.201217, 0.220310, 0.239211, 0.257893, 0.276336, 0.294527, 0.312457, 0.330119, 0.347508, 0.364621, 0.381457,
0.398015, 0.414293, 0.430293, 0.446014, 0.461458, 0.476625, 0.491516, 0.506134, 0.520479, 0.534554, 0.548361, 0.561901,
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0.296220, 0.295999, 0.295777, 0.295556, 0.295335, 0.295114, 0.294894, 0.294674 };
